## config/boards/shields/Kconfig.defconfig
```kconfig
if SHIELD_ALLIKECORNE_LEFT

config ZMK_KEYBOARD_NAME
    default "Allikecorne"

config ZMK_SPLIT_ROLE_CENTRAL
    default y

endif

if SHIELD_ALLIKECORNE_LEFT || SHIELD_ALLIKECORNE_RIGHT

config ZMK_SPLIT
    default y

endif
```

## config/boards/shields/Kconfig.shield
```kconfig
config SHIELD_ALLIKECORNE_LEFT
    def_bool $(shields_list_contains,Allikecorne_left)

config SHIELD_ALLIKECORNE_RIGHT
    def_bool $(shields_list_contains,Allikecorne_right)
```
